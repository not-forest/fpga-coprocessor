/* 
 * File: bcm2711-fpga-coprocessor.dtso
 * Desc: Device tree overlay for FPGA Coprocessor driver. Driver requires this device tree to be preloaded before
 * the driver itself to properly initialize.
 *
 * This dt overlay is compatible with bcm2711 (Raspberry Pi 4).
 */

/dts-v1/;
/plugin/;

/ {
    compatible = "brcm,bcm2711";

    /* 
     * Disables SPI device to transfer the ownership of this driver for direct communication with coprocessor. 
     */
    fragment@0 {
        target = <&spidev0>;
        __overlay__ {
            compatible = "coproc-spi";
            status = "disabled";  
        };
    };

    /*
     * Defines the coprocessor as a new SPI device.
     */ 
    fragment@1 {
        target = <&spi0>;
        __overlay__ {
            status = "okay";

            coprocessor: coprocessor@0 {
                compatible = "brightlight,coproc-spi";
                reg = <0>;
                spi-max-frequency = <4000000>;
                spi-bits-per-word = <8>;
                status = "okay";
            };
        };
    };
};
